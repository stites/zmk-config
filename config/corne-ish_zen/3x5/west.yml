## config/corne-ish_zen/3x5/west.yml
```yaml
manifest:
  remotes:
    - name: LOWPROKB
      url-base: https://github.com/LOWPROKB
    - name: stites
      url-base: https://github.com/stites
  projects:
    - name: zmk
      remote: stites
      revision: corne-ish-zen-v2+plover
      import: app/west.yml
  self:
    path: config
```

## config/corne-ish_zen/3x6/west.yml
```yaml
manifest:
  remotes:
    - name: LOWPROKB
      url-base: https://github.com/LOWPROKB
    - name: stites
      url-base: https://github.com/stites
  projects:
    - name: zmk
      remote: stites
      revision: zen-on-main+969+plover-hid
      #revision: zen-on-main+969+plover+mouse #<<< doesn't work!      
      import: app/west.yml
  self:
    path: config
```

## config/west.yml
```yaml
manifest:
  remotes:
    - name: upstream
      url-base: https://github.com/zmkfirmware
    - name: LOWPROKB
      url-base: https://github.com/LOWPROKB
    - name: stites
      url-base: https://github.com/stites
    - name: dnaq
      url-base: https://github.com/dnaq
  projects:
    #- name: zmk
    #  remote: stites
    #  revision: zen-on-main+969+plover-hid
    #  #revision: zen-on-main+969+plover+mouse #<<< doesn't work!
    #  import: app/west.yml
    - name: zmk
      remote: stites
      revision: main+zen-v1+plover
      import: app/west.yml
  self:
    path: config
```
